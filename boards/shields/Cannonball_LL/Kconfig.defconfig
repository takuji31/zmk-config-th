## boards/shields/Cannonball_LL/Kconfig.defconfig
```kconfig
if CANNONBALL_LL

    config ZMK_KEYBOARD_NAME
        default "Cannonball LL"

    config ZMK_POINTING
        default y

    config INPUT
        default y

    config EC11
        default y

endif
```
